## src/spl_core/config/KConfig
```kconfig
menu "SPL Core"
    menu "Linking"
        config LINKER_OUTPUT_FILE
            string "LINKER_OUTPUT_FILE"
            default "link_out.elf"
            help
              The main output file generated by the linker (e.g. main.exe or main.elf).

        config LINKER_BYPRODUCTS_CONFIG
            bool "LINKER_BYPRODUCTS_CONFIG"
            default n
            help
                Enable to configure other byproduct files generated by the linker

        config LINKER_BYPRODUCTS_EXTENSIONS
            string "LINKER_BYPRODUCTS_EXTENSIONS"
            depends on !LINKER_BYPRODUCTS_CONFIG
            default "hex,map,mdf"
            help
              The extensions of other byproducts generated by the linker (comma separated list, e.g., "hex,map,mdf")

        config LINKER_BYPRODUCT_HEX
            string "LINKER_BYPRODUCT_HEX"
            depends on LINKER_BYPRODUCTS_CONFIG
            default "link_out.hex"
            help
              The hex file generated by the linker

        config LINKER_BYPRODUCT_MAP
            string "LINKER_BYPRODUCT_MAP"
            depends on LINKER_BYPRODUCTS_CONFIG
            default "link_out.map"
            help
              The map file generated by the linker

        config LINKER_BYPRODUCT_MDF
            string "LINKER_BYPRODUCT_MDF"
            depends on LINKER_BYPRODUCTS_CONFIG
            default "link_out.mdf"
            help
              The mdf file generated by the linker

        config LINKER_BYPRODUCT_OTHERS
            string "LINKER_BYPRODUCT_OTHERS"
            depends on LINKER_BYPRODUCTS_CONFIG
            default ""
            help
              Other byproduct files generated by the linker (comma separated list, e.g., "link_out.xml")
    endmenu
endmenu
```

## src/spl_core/kickstart/templates/application/KConfig
```kconfig
mainmenu "SPL Example"

menu "Linking"
    config LINKER_OUTPUT_FILE
        string
        prompt "LINKER_OUTPUT_FILE"
        default "my_main.exe"
        help
          The output file generated by the linker (e.g. my_main.exe).

    config LINKER_BYPRODUCTS_EXTENSIONS
        string
        prompt "LINKER_BYPRODUCTS_EXTENSIONS"
        default "map"
        help
          The extensions of other byproducts generated by the linker (e.g. map)
endmenu

menu "Feature Model"
    config LANG_DE
        bool "German language selection"
        default n
endmenu
```
